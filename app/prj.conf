## CMakeLists.txt
```
# SPDX-License-Identifier: Apache-2.0

cmake_minimum_required(VERSION 3.20.0)

find_package(Zephyr)
project(weather_station)

target_sources(app PRIVATE
    src/main.c
    src/subsystems/fake_sensor.c
    src/subsystems/sensor_mgr.c
    src/subsystems/display_mgr.c
    src/subsystems/shell_iface.c
)

target_include_directories(app PRIVATE
    src/common
)
```

## Kconfig
```
# SPDX-License-Identifier: Apache-2.0

# Weather Station Application Configuration

menu "Weather Station Configuration"

config WEATHER_STATION_FAKE_SENSOR
	bool "Use fake sensor for testing"
	default y
	help
	  Enable this option to use a fake sensor instead of real hardware.
	  This is useful for testing on native_sim/native/64 or other simulator platforms.

config WEATHER_STATION_LOG_LEVEL
	int "Weather Station Log Level"
	range 0 4
	default 3
	help
	  Set the log level for weather station specific messages.
	  0 = Off, 1 = Error, 2 = Warning, 3 = Info, 4 = Debug

endmenu

source "Kconfig.zephyr"
```

## prj.conf
```kconfig
# Weather Station Configuration

# Enable required Zephyr subsystems
CONFIG_ZBUS=y
CONFIG_SENSOR=y
CONFIG_SHELL=y
CONFIG_LOG=y

# Enable fake sensor for native_sim
CONFIG_WEATHER_STATION_FAKE_SENSOR=y
CONFIG_WEATHER_STATION_LOG_LEVEL=4
```

## src/main.c
```c
/*
 * Copyright (c) 2024 Zephyr Weather Station
 *
 * SPDX-License-Identifier: Apache-2.0
 */

#include <zephyr/kernel.h>
#include <zephyr/logging/log.h>
#include <zephyr/zbus/zbus.h>
#include "common/messages.h"

LOG_MODULE_REGISTER(main, CONFIG_WEATHER_STATION_LOG_LEVEL);

// Define zbus channels (must be global)
ZBUS_CHAN_DEFINE(ws_trigger,
                struct trigger_msg,
                NULL,
                NULL,
                ZBUS_OBSERVERS(sensor_mgr_listener),
                ZBUS_MSG_INIT());

ZBUS_CHAN_DEFINE(ws_sensor_data,
                struct sensor_data_msg,
                NULL,
                NULL,
                ZBUS_OBSERVERS(display_mgr_listener, shell_iface_listener),
                ZBUS_MSG_INIT());

int main(void)
{
    LOG_INF("Weather Station starting...");

    // ZBUS is automatically initialized by the system

    LOG_INF("Weather Station initialized. Type 'ws trigger' to request sensor reading.");
    LOG_INF("Available commands: ws trigger, ws show, ws status");

    return 0;
}
```
