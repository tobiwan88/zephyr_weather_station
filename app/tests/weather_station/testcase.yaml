## app/tests/weather_station/testcase.yaml
```yaml
tests:
  utilities.weather_station:
    tags:
      - zbus
      - sensor
      - display
      - weather
    type: unit
    build_only: true
    platform_allow:
      - native_sim
    integration_platforms:
      - native_sim
    tags: test_framework
```

## west.yml
```yaml
manifest:
  defaults:
    remote: upstream

  remotes:
    - name: upstream
      url-base: https://github.com/zephyrproject-rtos

  projects:
    - name: zephyr
      remote: upstream
      revision: v4.3.0
      import:
        # Minimal modules for native_sim and console only
        name-allowlist:
          - segger       # For RTT console support (optional)
          - net-tools    # For network simulation tools

  self:
    path: zephyr_weather_station
```
